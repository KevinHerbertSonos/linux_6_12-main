## drivers/synaptics/staging/dspg/coma/Kconfig
```kconfig
config CFIFO_CHECKS
	bool "CFIFO runtime checks"
	depends on DSPG_CSS
	help
	  Say Y here to enable runtime checks that verify the integrity of
	  CFIFOs as they are used. This adds some overhead which is
	  unnecessary, except for debugging.

	  If unsure, say N.

config DSPG_COMA_MAX_SERVICES
	int "Maximum number of services"
	depends on DSPG_CSS
	default 16
	help
	  Sets the maximum number of simultaneously active COMA services in the
	  kernel.

config DSPG_COMA_SOCKET
	bool "COMA socket family support"
	depends on DSPG_CSS && NET
	default y
	help
	  Say Y here to enable support for the COMA scket family. This socket
	  family is used by user space processes to connect to services of the
	  cordless domain.

config DSPG_CSS_VOICE
	bool "COMA voice/RTP service"
	depends on DSPG_CSS
	help
	  Character device interface for passing RTP streams between CSS and
	  UDP sockets.

config CORDLESS_NUM_VOICELINES
	int "Voice Channels"
	depends on DSPG_CSS_VOICE
	default 16
	help
	  Number of VOICE channels

config CORDLESS_USER_SPACE_FIFOS
	bool "User Space CFIFO handling"
	depends on DSPG_CSS_VOICE
	default n
	help
	  CFIFOs are handled in user-space.

config DSPG_CSS_TDM
	bool "COMA TDM service"
	depends on DSPG_CSS
	help
	  Interface for passing ownership of TDM interfaces to the CSS.

config DSPG_CSS_DVF9A
	bool "COMA DVF9A service"
	depends on DSPG_CSS && MFD_DSPG_DVF9A
	help
	  Interface for accessing the DVF9A through DAIF and handling interrupts

config DSPG_CSS_ALSA
	bool "COMA ALSA service"
	depends on DSPG_CSS
	help
	  Interface for PCM ALSA

config DSPG_CSS_SHAREDMEM
	bool "COMA SHAREDMEM service"
	depends on DSPG_CSS
	help
	  Interface for the shared memory service (/dev/sharedmem)
```

## drivers/synaptics/tty/Kconfig
```kconfig
# SPDX-License-Identifier: GPL-2.0
#

menuconfig SYNAPTICS_TTY
  bool "Synaptics tty driver support"
  default y
  help
    Synaptics tty driver support

if SYNAPTICS_TTY

source "drivers/synaptics/tty/serial/Kconfig"

endif
```

## drivers/synaptics/tty/serial/Kconfig
```kconfig
# SPDX-License-Identifier: GPL-2.0
#
# Serial device configuration
#

config SERIAL_DSPG_UART
	tristate "DSPG UART support"
	select SERIAL_CORE
	help
	  This driver supports the DSPG UART port.

config SERIAL_DSPG_CONSOLE
	bool "Support for console on DSPG DW serial port"
	depends on SERIAL_DSPG_UART
	select SERIAL_CORE_CONSOLE
	select SERIAL_EARLYCON
	help
	  Say Y here if you wish to use DSPG DW UART as the system
	  console (the system console is the device which receives all kernel
	  messages and warnings and which allows logins in single user mode).

	  Even if you say Y here, the currently visible framebuffer console
	  (/dev/tty0) will still be used as the system console by default, but
	  you can alter that using a kernel command line option such as
	  "console=ttyDW0". (Try "man bootparam" or see the documentation of
	  your boot loader (lilo or loadlin) about how to pass options to the
	  kernel at boot time.)

config SERIAL_DSPG_TTYDW
	bool "Install as device ttyDWn instead of ttySn"
	depends on SERIAL_DSPG_UART=y
	help
	  Say Y here if you wish to have the internal DW UARTs
	  appear as /dev/ttyDWn (major 254, minor starting at 74)
	  instead of the normal /dev/ttySn (major 4, minor starting at
	  64). This is necessary if you also want other UARTs, such as
	  external 8250/16C550 compatible UARTs.
	  The ttySn nodes are legally reserved for the 8250 serial driver
	  but are often misused by other serial drivers.

	  To use this, you should create suitable ttyDWn device nodes in
	  /dev/, and pass "console=ttyDWn" to the kernel.

	  Say Y if you have an external 8250/16C550 UART.  If unsure, say N.

config SERIAL_DSPG_TDM_UART
	tristate "DSPG Software UART support"
	select SERIAL_CORE
	select DMW96_GDMAC
	help
	  This driver supports the DSPG software UART port via TDM.
```

## drivers/synaptics/usb/Kconfig
```kconfig
# SPDX-License-Identifier: GPL-2.0

menuconfig SYNAPTICS_USB
  bool "Synaptics usb driver support"
  default y
  help
    Synaptics usb driver support

if SYNAPTICS_USB

source "drivers/synaptics/usb/dwc3/Kconfig"
source "drivers/synaptics/usb/musb_fdrc/Kconfig"

endif
```

## drivers/synaptics/usb/dwc3/Kconfig
```kconfig
# SPDX-License-Identifier: GPL-2.0

config USB_DWC3_SYNA
	tristate "Synaptics Platforms"
	depends on (ARCH_BERLIN || COMPILE_TEST) && OF
	default USB_DWC3
	help
	  Synaptics SOCs with dwc3 IP.
	  Say 'Y' or 'M' if you have one such device.
```

## drivers/synaptics/usb/musb_fdrc/Kconfig
```kconfig
#
# USB Dual Role (OTG-ready) Controller Drivers
# for silicon based on Mentor Graphics INVENTRA designs
#

# (M)FDRC = (Multipoint) Highspeed Dual-Role Controller
config USB_MUSB_FDRC
	tristate 'Inventra Fullspeed Dual Role Controller (DSPG DVF99)'
	depends on USB
	select NOP_USB_XCEIV if (ARCH_DAVINCI || MACH_OMAP3EVM || BLACKFIN || ARCH_DVF)
	select TWL4030_USB if MACH_OMAP_3430SDP
	select TWL6030_USB if MACH_OMAP_4430SDP || MACH_OMAP4_PANDA
	select USB_OTG_UTILS
	select USB_GADGET_DUALSPEED
	help
	  Say Y here if your system has a dual role high speed USB
	  controller based on the Mentor Graphics silicon IP.  Then
	  configure options to match your silicon and the board
	  it's being used with, including the USB peripheral role,
	  or the USB host role, or both.

	  Texas Instruments familiies using this IP include DaVinci
	  (35x, 644x ...), OMAP 243x, OMAP 3, and TUSB 6010.

	  Analog Devices parts using this IP include Blackfin BF54x,
	  BF525 and BF527.

	  If you do not know what this is, please say N.

	  To compile this driver as a module, choose M here; the
	  module will be called "musb-fdrc".

if USB_MUSB_FDRC

choice
	prompt "Platform Glue Layer"

config USB_MUSB_DVF99
	bool "DVF99 to dvf99"
	depends on ARCH_DVF

endchoice

choice
	prompt 'MUSB DMA mode'
	default MUSB_FDRC_PIO_ONLY if USB_MUSB_DVF99
	help
	  Unfortunately, only one option can be enabled here. Ideally one
	  should be able to build all these drivers into one kernel to
	  allow using DMA on multiplatform kernels.

config USB_MUSB_FDRC_INVENTRA_DMA
	bool 'Inventra'
	depends on USB_MUSB_DVF99
	help
	  Enable DMA transfers using Mentor's engine.

config MUSB_FDRC_PIO_ONLY
	bool 'Disable DMA (always use PIO)'
	help
	  All data is copied between memory and FIFO by the CPU.
	  DMA controllers are ignored.

	  Do not choose this unless DMA support for your SOC or board
	  is unavailable (or unstable).  When DMA is enabled at compile time,
	  you can still disable it at run time using the "use_dma=n" module
	  parameter.

endchoice

endif # USB_MUSB_FDRC
```

## drivers/synaptics/video/Kconfig
```kconfig
# SPDX-License-Identifier: GPL-2.0-only
#
# Video configuration
#

menuconfig SYNAPTICS_VIDEO
  bool "Synaptics video driver support"
  default y
  help
    Synaptics video driver support

if SYNAPTICS_VIDEO

source "drivers/synaptics/video/syna/Kconfig"

source "drivers/synaptics/video/fbdev/Kconfig"

source "drivers/synaptics/video/backlight/Kconfig"

source "drivers/synaptics/gpu/dsi/Kconfig"

source "drivers/synaptics/gpu/arm/mali/Kconfig"

source "drivers/synaptics/gpu/vivante/Kconfig"

endif
```

## drivers/synaptics/video/backlight/Kconfig
```kconfig
# SPDX-License-Identifier: GPL-2.0-only
#
# Backlight & LCD drivers configuration
#

config BACKLIGHT_DVF9A
	tristate "Backlight driver for the DSPG-DVF9A"
	depends on MFD_DSPG_DVF9A
	help
	  This supports the DSPG-DVF9A backlight driver.
```

## drivers/synaptics/video/fbdev/Kconfig
```kconfig
# SPDX-License-Identifier: GPL-2.0-only
#
# fbdev configuration
#

config FB_DSPG
	tristate "DSPG framebuffer support"
	depends on FB && ARM
	select FB_CFB_FILLRECT
	select FB_CFB_COPYAREA
	select FB_CFB_IMAGEBLIT
	help
	  Choose this option if you want to use the DSPG-LCDC device as a
	  framebuffer device.

config FB_DSPG_EXT_TE
	bool "DSPG framebuffer external TE trigger support"
	default y
	depends on FB_DSPG && MFD_SYSCON
	select REGMAP

config FB_ST7528
	tristate "ST7528 framebuffer support"
	depends on FB && ARM && SPI_MASTER
	select FB_CFB_FILLRECT
	select FB_CFB_COPYAREA
	select FB_CFB_IMAGEBLIT
	select FB_DEFERRED_IO
	help
	  Choose this option if you want to use the ST7528 based device as a
	  framebuffer device.

menu "ST7528 framebuffer options"
	depends on FB_ST7528

config FB_ST7528_FPS
	int "Number of frames per second to update in bruteforce mode"
	default 10
	help
	  This sets the default number of frames per second the display
	  will get updated in bruteforce mode.

config FB_ST7528_DEFERRED_IO_DELAY
	int "Number of jiffies to wait before display will be updated"
	default 5
	help
	  This sets the delay in jiffies after the deferred IO will start to
	  write data to the display.

endmenu

config FB_MPMC
	tristate "MPMC framebuffer support"
	depends on FB && ARCH_DVF
	select FB_CFB_FILLRECT
	select FB_CFB_COPYAREA
	select FB_CFB_IMAGEBLIT
	select FB_DEFERRED_IO
	help
	  Choose this option if you want to use the MPMC based device as a
	  framebuffer device.
```

## drivers/synaptics/watchdog/Kconfig
```kconfig
# SPDX-License-Identifier: GPL-2.0-only

#
# Watchdog device configuration
#

menuconfig SYNAPTICS_WATCHDOG
  bool "Synaptics wtd driver support"
  default y
  help
    Synaptics wtd driver support

if SYNAPTICS_WATCHDOG

config DSPG_WATCHDOG
	tristate "DSPG watchdog"
	depends on PLAT_DVF
	select WATCHDOG_CORE
	help
	  Say Y here to include support for the watchdog timer for the
	  DSPG SoCs.
	  To compile this driver as a module, choose M here: the
	  module will be called dspg_wdt.

endif
```
