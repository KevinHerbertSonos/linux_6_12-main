## drivers/synaptics/Kconfig
```kconfig
# SPDX-License-Identifier: GPL-2.0
#
# Synaptics driver config
#

menu "Synaptics drivers"

source "drivers/synaptics/clk/Kconfig"

source "drivers/synaptics/pinctrl/Kconfig"

source "drivers/synaptics/mmc/Kconfig"

source "drivers/synaptics/usb/Kconfig"

source "drivers/synaptics/pci/Kconfig"

source "drivers/synaptics/regulator/Kconfig"

source "drivers/synaptics/phy/Kconfig"

source "drivers/synaptics/hwmon/Kconfig"

source "drivers/synaptics/i2c/Kconfig"

source "drivers/synaptics/soc/Kconfig"

source "drivers/synaptics/net/Kconfig"

source "drivers/synaptics/video/Kconfig"

source "drivers/synaptics/sound/Kconfig"

source "drivers/synaptics/devfreq/Kconfig"

source "drivers/synaptics/dma-buf/Kconfig"

source "drivers/synaptics/irqchip/Kconfig"

source "drivers/synaptics/input/Kconfig"

source "drivers/synaptics/bluetooth/Kconfig"

source "drivers/synaptics/clocksource/Kconfig"

source "drivers/synaptics/dma/Kconfig"

source "drivers/synaptics/gpu/trace/Kconfig"

source "drivers/synaptics/tty/Kconfig"

source "drivers/synaptics/leds/Kconfig"

source "drivers/synaptics/mfd/Kconfig"

source "drivers/synaptics/misc/Kconfig"

source "drivers/synaptics/mtd/Kconfig"

source "drivers/synaptics/pwm/Kconfig"

source "drivers/synaptics/reset/Kconfig"

source "drivers/synaptics/rtc/Kconfig"

source "drivers/synaptics/spi/Kconfig"

source "drivers/synaptics/staging/Kconfig"

source "drivers/synaptics/watchdog/Kconfig"

source "drivers/synaptics/mailbox/Kconfig"

source "drivers/synaptics/rpmsg/Kconfig"

source "drivers/synaptics/hrx-v4l2/Kconfig"

endmenu
```

## drivers/synaptics/clk/berlin/Kconfig
```kconfig
# SPDX-License-Identifier: GPL-2.0-only

config SYNA_DOLPHIN_PLL
	tristate "Synaptics DOLPHIN pll drivers"
	depends on ARCH_BERLIN
	help
	  Build the pll drivers for berlin DOLPHIN/PLATYPUS SOCs.

config SYNA_AS370_PLL
	tristate "Synaptics AS370 pll drivers"
	depends on ARCH_BERLIN
	help
	  Build the pll drivers for berlin AS370/MYNA SOCs.

config SYNA_CLK_BASE
	tristate "Synaptics switch/gate base drivers"
	depends on ARCH_BERLIN
	help
	  Build the base clk driver for synaptics SOCs.

config SYNA_AS370_CLK
	tristate "Synaptics AS370 SOC's switch/gate clk drivers"
	depends on SYNA_CLK_BASE
	help
	  Build the clk drivers for berlin AS370 SOCs.

config SYNA_MYNA_CLK
	tristate "Synaptics MYNA SOC's switch/gate clk drivers"
	depends on SYNA_CLK_BASE
	help
	  Build the clk drivers for berlin MYNA SOCs.

config SYNA_MYNA2_CLK
        tristate "Synaptics MYNA2 SOC's switch/gate clk drivers"
        depends on SYNA_CLK_BASE
        help
          Build the clk drivers for berlin MYNA2 SOCs.

config SYNA_PLATYPUS_CLK
	tristate "Synaptics PLATYPUS SOC's switch/gate clk drivers"
	depends on SYNA_CLK_BASE
	help
	  Build the clk drivers for berlin PLATYPUS SOCs.

config SYNA_DOLPHIN_CLK
	tristate "Synaptics DOLPHIN SOC's switch/gate clk drivers"
	depends on SYNA_CLK_BASE
	help
	  Build the clk drivers for berlin DOLPHIN SOCs.

config SYNA_SL261X_CLK
	tristate "Synaptics SL261X SOC's clk drivers"
	depends on SYNA_CLK_BASE
	default n
	help
	  Build the clk drivers for Synaptics SL261X SOCs.
```

## drivers/synaptics/net/wireless/Kconfig
```kconfig
# SPDX-License-Identifier: GPL-2.0-only
#
# Wireless LAN device configuration
#

config BCMDHD103
	bool "BCMDHD103"
	default n

config BCMDHD591
	bool "BCMDHD591"
	default n

config BCMDHD361
	bool "BCMDHD361"
	default n

source "drivers/synaptics/net/wireless/bcmdhd/Kconfig"
if BCMDHD103
source "drivers/synaptics/net/wireless/bcmdhd103/Kconfig"
endif
if BCMDHD591
source "drivers/synaptics/net/wireless/bcmdhd591/Kconfig"
endif
if BCMDHD361
source "drivers/synaptics/net/wireless/bcmdhd361/Kconfig"
endif
```

## drivers/synaptics/regulator/Kconfig
```kconfig
# SPDX-License-Identifier: GPL-2.0-only
menuconfig SYNAPTICS_REGULATOR
  bool "Synaptics regulator driver support"
  default y
  help
    Synaptics regulator driver support

if SYNAPTICS_REGULATOR

config REGULATOR_HL7593
	tristate "Halo HL7593 regulator"
	depends on I2C && (OF || COMPILE_TEST)
	select REGMAP_I2C
	help
	  This driver supports HL7593 single output regulator.

config REGULATOR_DVF9A
	tristate "DSPG-DVF9A PMU"
	depends on MFD_DSPG_DVF9A
	help
	  This driver provides support for the voltage regulators on the
	  DSPG-DVF9A PMU.

config REGULATOR_DVFA10_LDO_DSI
	tristate "DSPG-DVFA10 LDO DSI"
	depends on MFD_DSPG_DVF9A
	help
	  This driver provides support for the LDO DSI voltage regulator
	  on the DSPG-DVFA10 PMU.

config REGULATOR_RPI_PANEL_ATTINY
	tristate "ATtiny RPI Panel Regulator"
	depends on I2C && (OF || COMPILE_TEST)
	select REGMAP_I2C
	help
	  This driver provides support for the ATtiny RPI panel regulator.

endif
```

## drivers/synaptics/rpmsg/Kconfig
```kconfig
# SPDX-License-Identifier: GPL-2.0-only

#
# rpmsg configuration
#

menuconfig SYNAPTICS_RPMSG
  bool "Synaptics RPMSG support"
  default y
  help
    Synaptics RPMSG support

if SYNAPTICS_RPMSG

config SYNA_RPMSG
	tristate "Synaptics RPMSG Driver"
	depends on MAILBOX
	select RPMSG
	default n
	help
	  Say y here to enable support for the Synaptics RPMSG Driver
	  providing communication channels to remote processors in Synaptics
	  platforms.

config RPMSG_CLIENT_PINGPONG
	tristate "RPMSG client pingpong demo -- module only"
	depends on SYNA_RPMSG && m
	default n
	help
	  One unsigned int transactions rpmsg client demo between Linux and
	  the remote mcu in Synaptics platforms.

endif
```

## drivers/synaptics/soc/berlin/Kconfig
```kconfig
# SPDX-License-Identifier: GPL-2.0-only
#
# Berlin SoC drivers
#
menu "Berlin SoC drivers"
	depends on ARCH_BERLIN || COMPILE_TEST

source "drivers/synaptics/soc/berlin/Kconfig.avio"
source "drivers/synaptics/soc/berlin/Kconfig.isp"
source "drivers/synaptics/soc/berlin/Kconfig.gpu"

config BERLIN_CHIPID
	tristate "Support BERLIN CHIPID"
	default n
	select SOC_BUS
	help
	  If you say Y here you get support for the BERLIN CHIP id

config BERLIN_SM
	tristate "Support SM CPU"
	default n
	select POWER_RESET
	select REBOOT_MODE
	help
	  Enable support for SM(System Manager) which is designed for front
	  panel control and power management.

config BERLIN_TZD
	tristate "Support Synaptics ARM TrustZone"
	default n
	help
	  Enable support for Synaptics ARM TrustZone

config BERLIN_SHM
	tristate "Support BERLIN SHM"
	default n
	help
	  SHM support

config BERLIN_VPP_MEM
	tristate "Support BERLIN VPP MEM module"
	default n
	help
	  VPP MEM support

config BERLIN_VPP
	tristate "Support Berlin VPP module"
	default n
	depends on DMABUF_HEAPS && BERLIN_AVIO
	help
	  This is the VPP module for Berlin.

config BERLIN_CC
	tristate "Support BERLIN CC"
	default n
	help
	  Enable support for BERLIN CC

config BERLIN_AVIO
	tristate "Support AVIO"
	default n
	select BERLIN_MSGQ
	help
	  Enable support for AVIO

config BERLIN_MSGQ
	tristate "Support Message Q"
	default n
	help
	  Enable support for MSGQ

config BERLIN_VPU
	tristate "Support Synaptics VPU"
	imply BERLIN_VPU_AMP
	help
	  Support Synaptics VPU multiple interfaces

config BERLIN_VPU_AMP
	bool "Support VPU AMP interface"
	depends on BERLIN_VPU

config BERLIN_VPU_V4L2
	bool "Support VPU V4L2 M2M interface"
	depends on VIDEO_DEV
	select VIDEOBUF2_MEMOPS
	select DMA_SHARED_BUFFER
	select V4L2_MEM2MEM_DEV
	depends on BERLIN_BM
	depends on BERLIN_VPU

config SYNA_ISP
	tristate "Support for ISP"
	default n
	help
	  isp core driver

config BERLIN_TSP
	tristate "Support BERLIN TSP"
	default n
	select BERLIN_MSGQ
	help
	  Enable support for TSP

config BERLIN_AXI_METER
	tristate "Support AXI performance meter"
	default n
	help
	  axi performance meter support

config BERLIN_AOUT
	tristate "Support BERLIN AOUT"
	default n
	select BERLIN_DHUB_IRQ
	depends on BERLIN_MSGQ && BERLIN_SHM && BERLIN_AVIO
	help
	  AOUT support

config POWERVR_ROGUE
	tristate "PowerVR rogue android driver"
	default n
	help
	  Imagination gpu driver for android

config POWERVR_ROGUE_WS
	tristate "PowerVR rogue Linux window system driver"
	default n
	help
	  Imagination gpu driver for Linux window system

config BERLIN_NSK
	tristate "Support BERLIN NSK"
	default n
	help
	  NSK support

config BERLIN_OVP
	tristate "Support OVP"
	default n
	select BERLIN_MSGQ
	select BERLIN_TZD
	help
	  Enable support for OVP

config BERLIN_SCRD
	tristate "Support BERLIN SMARTCARD"
	default n
	select BERLIN_MSGQ
	help
	  Enable support for Smart card

config BERLIN_CEC
	tristate "Support BERLIN CEC"
	default n
	select BERLIN_MSGQ
	help
	  Enable support for CEC

config HIFI_DSP
	tristate "Support HIFI DSP"
	default n
	depends on BERLIN_MSGQ
	help
	  DSP support

config BERLIN_VSYNC
	tristate "Support BERLIN VSYNC"
	default n
	help
	  Enable Berlin Vsync

config BERLIN_HRX
	tristate "Support BERLIN HRX"
	default n
	select BERLIN_DHUB_IRQ
	depends on BERLIN_MSGQ && BERLIN_SHM && BERLIN_AVIO
	help
	  HRX support

config BERLIN_IFCP
	tristate "Support Irdeto IFCP"
	default n
	help
	  Enable support for Irdeto IFCP

config BERLIN_BM
	tristate "Support BERLIN BM"
	default n
	depends on DMABUF_HEAPS_EXTRA
	help
	 AMP buffer meta data management module

config SYNAPTICS_BT_DEVICE
	tristate "BT Device support"
	depends on BT && RFKILL
	default n
	help
	  Say Y here if you want to use the BT device.

config SYNA_DRM
	tristate "synaptics drm display module"
	default n
	select BERLIN_VPP
	select BERLIN_AVIO
	select DRM_KMS_HELPER
	select DRM_TTM
	select DRM_TTM_HELPER
	help
	  synaptics drm display support

config SYNA_DRM_BRIDGE_LT9611
	bool "syna compatible lt9611 drm bridge"
	default n
	depends on SYNA_DRM
	help
	  syna compatible lt9611 drm bridge

config SYNA_WSPANEL_1080P
	tristate "syna compatible wspanel 1080p resolution"
	default n
	depends on SYNA_DRM
	help
	  syna compatible waveshare 13.3 inch 1080P panel

config SYNA_MC_DFC
	tristate "Support MC hwcc"
	default n
	help
	  MC DFC HWCC for DDR frequency switch on the fly.

config MEDIA_DRM
	tristate "Support synaptics media drm"
	default n
	help
	  synaptics media drm module

endmenu
```

## drivers/synaptics/sound/Kconfig
```kconfig
# SPDX-License-Identifier: GPL-2.0-only

menuconfig SYNAPTICS_SOUND
  bool "Synaptics sound driver support"
  default y
  help
    Synaptics sound driver support

if SYNAPTICS_SOUND

source "drivers/synaptics/sound/soc/syna/Kconfig"
source "drivers/synaptics/sound/soc/codecs/Kconfig"

endif
```

## drivers/synaptics/sound/soc/codecs/Kconfig
```kconfig
# SPDX-License-Identifier: GPL-2.0-only
menu "CODEC drivers"

config SND_SOC_CX9000
	tristate "Synaptics CX9000 AMPLIFIER"
	depends on I2C
	default n

endmenu
```
