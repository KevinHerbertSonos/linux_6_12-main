## drivers/synaptics/mtd/Kconfig
```kconfig
menuconfig SYNAPTICS_MTD
  bool "Synaptics mtd driver support"
  default y
  help
    Synaptics MTD driver support

if SYNAPTICS_MTD

source "drivers/synaptics/mtd/devices/Kconfig"

source "drivers/synaptics/mtd/nand/Kconfig"

endif
```

## drivers/synaptics/mtd/devices/Kconfig
```kconfig
# SPDX-License-Identifier: GPL-2.0-only

config MTD_DSPG_QSPIC
	tristate "DSPG QSPI controller"
	help
	  This provides a MTD device driver for the DSPG QSPI controller. The
	  driver supports various DataFlash devices on both chip selects of the
	  controller.
```

## drivers/synaptics/mtd/nand/Kconfig
```kconfig
# SPDX-License-Identifier: GPL-2.0-only


source "drivers/synaptics/mtd/nand/raw/Kconfig"

config MTD_NAND_CADENCE
        tristate "Support for the Cadence NAND controller"
        default y
```

## drivers/synaptics/mtd/nand/raw/Kconfig
```kconfig
# SPDX-License-Identifier: GPL-2.0-only

config MTD_NAND_DSPG
	tristate "Support for DSPG NAND controller"
	help
		Enables support for DSPG NAND flash controllers.
```

## drivers/synaptics/net/Kconfig
```kconfig
# SPDX-License-Identifier: GPL-2.0-only
#
# Network device configuration
#

menuconfig SYNAPTICS_NET
  bool "Synaptics Net driver support"
  default y
  help
    Synaptics Net driver support

if SYNAPTICS_NET

source "drivers/synaptics/net/phy/Kconfig"

source "drivers/synaptics/net/wireless/Kconfig"

source "drivers/synaptics/net/dsa/Kconfig"

source "drivers/synaptics/net/ethernet/Kconfig"

endif
```

## drivers/synaptics/net/dsa/Kconfig
```kconfig
# SPDX-License-Identifier: GPL-2.0-only

config NET_DSA_RTL8363SB
	tristate "Realtek 8363SB/NB ethernet switch chip support"
	depends on NET_DSA
	select NET_DSA_TAG_EDSA
	help
	  This enables support for the Realtek 8363SB/NB ethernet switch chips.
```

## drivers/synaptics/net/ethernet/Kconfig
```kconfig
# SPDX-License-Identifier: GPL-2.0-only
#
# Ethernet LAN device configuration
#

source "drivers/synaptics/net/ethernet/stmicro/Kconfig"
```

## drivers/synaptics/net/ethernet/stmicro/Kconfig
```kconfig
# SPDX-License-Identifier: GPL-2.0-only
#
# STMicroelectronics device configuration
#

if NET_VENDOR_STMICRO

source "drivers/synaptics/net/ethernet/stmicro/stmmac/Kconfig"

endif # NET_VENDOR_STMICRO
```

## drivers/synaptics/net/ethernet/stmicro/stmmac/Kconfig
```kconfig
# SPDX-License-Identifier: GPL-2.0-only

config DWMAC_DVF
	tristate "DVF DWMAC support"
	default PLAT_DVF
	depends on OF
	help
	  Support for DVF DWMAC Ethernet controller.

	  This selects the Anarion SoC glue layer support for the stmmac driver.
```

## drivers/synaptics/net/phy/Kconfig
```kconfig
# SPDX-License-Identifier: GPL-2.0-only
#
# PHY Layer Configuration
#

config SUNPLUS_PHY
	tristate "SUNPLUS PHYs"
	help
	  Supports the SUNPLUS PHY.
```

## drivers/synaptics/pci/Kconfig
```kconfig
# SPDX-License-Identifier: GPL-2.0

menuconfig SYNAPTICS_PCIE
  bool "Synaptics PCIe driver support"
  default y
  help
    Synaptics PCIe driver support

if SYNAPTICS_PCIE

config PCIE_BERLIN
	tristate "Synaptics Berlin PCIe controller"
	depends on PCI
	depends on ARCH_BERLIN && OF
        depends on PCI_MSI_IRQ_DOMAIN != ""
	select PCIE_DW_HOST

endif
```

## drivers/synaptics/phy/Kconfig
```kconfig
#
# Phy drivers for Synaptics platforms
#

menuconfig SYNAPTICS_PHY
  bool "Synaptics phy driver support"
  default y
  help
    Synaptics PHY driver support

if SYNAPTICS_PHY

source "drivers/synaptics/phy/synaptics/Kconfig"

config PHY_SYNOPSYS_USB_PICOPHY
	tristate "Synopsys USB PicoPHY support for DVF platforms"
	depends on PLAT_DVF
	select GENERIC_PHY
	help
	  Say Y here to add support for the Synopsys PicoPHY. The PHY can be
	  connected to host or dual-role/OTG controllers on DSPG DVF platforms.

endif
```

## drivers/synaptics/pinctrl/Kconfig
```kconfig
# SPDX-License-Identifier: GPL-2.0-only
#

menuconfig SYNAPTICS_PINCTRL
  bool "Synaptics pinctrl driver support"
  default y
  help
    Synaptics pinctrl driver support

if SYNAPTICS_PINCTRL

source "drivers/synaptics/pinctrl/berlin/Kconfig"

config PINCTRL_DVF
	bool "DSPG DVF99 SoC pinctrl driver"
	depends on ARCH_DVF && OF
	select PINMUX
	select PINCONF

config PINCTRL_DVF101
	bool "DSPG DVF101 SoC pinctrl driver"
	depends on (ARCH_DVF101 || ARCH_DVF) && OF && GPIOLIB
	select PINMUX
	select PINCONF

endif
```

## drivers/synaptics/pinctrl/berlin/Kconfig
```kconfig
# SPDX-License-Identifier: GPL-2.0-only
if (ARCH_BERLIN || COMPILE_TEST)

config PINCTRL_BERLIN
	tristate "Synaptics berlin pin controller driver lib"
	select PINMUX
	select GENERIC_PINCONF
	select REGMAP_MMIO

config PINCTRL_AS370
	bool "Synaptics as370 pin controller driver"
	depends on OF
	select PINCTRL_BERLIN

config PINCTRL_MYNA
	bool "Synaptics myna pin controller driver"
	depends on OF
	select PINCTRL_BERLIN

config PINCTRL_MYNA2
	tristate "Synaptics myna2 pin controller driver"
	depends on OF
	select PINCTRL_BERLIN

config PINCTRL_PLATYPUS
	tristate "Synaptics PLATYPUS pin controller driver"
	depends on OF
	select PINCTRL_BERLIN

config PINCTRL_DOLPHIN
	tristate "Synaptics DOLPHIN pin controller driver"
	depends on OF
	select PINCTRL_BERLIN

config PINCTRL_SL261X
	tristate "Synaptics SL261X pin controller driver"
	depends on OF
	select PINCTRL_BERLIN

endif
```

## drivers/synaptics/pwm/Kconfig
```kconfig
# SPDX-License-Identifier: GPL-2.0-only

menuconfig SYNAPTICS_PWM
  bool "Synaptics PWM driver support"
  default y
  help
    Synaptics PWM driver support

if SYNAPTICS_PWM

config PWM_DVF
	tristate "DVF PWM support"
	depends on ARCH_DVF101
	help
	  Generic PWM framework driver for DVF based platforms.

	  To compile this driver as a module, choose M here: the module
	  will be called pwm-dvf.

endif
```

## drivers/synaptics/reset/Kconfig
```kconfig
# SPDX-License-Identifier: GPL-2.0-only

menuconfig SYNAPTICS_RESET
  bool "Synaptics reset driver support"
  default y
  help
    Synaptics reset driver support

if SYNAPTICS_RESET

config RESET_BERLIN
	tristate "Berlin Reset Driver"
	depends on ARCH_BERLIN || COMPILE_TEST
	default m if ARCH_BERLIN
	help
	  This enables the reset controller driver for Marvell Berlin SoCs.

config GPIO_RESET_CONTROLLER
	tristate "GPIO reset controller"
	help
	  Reset controller using GPIO lines

	  There are two main methods of using this controller:
	  * As a reset controller within the reset framework allowing device
	  drivers to request a hardware reset of their devices.
	  * As a standalone driver performing reset at boot or upon userspace
	  request (via sysfs)
	  The second method is suitable for devices on discoverable busses
	  (SDIO, USB)

source "drivers/synaptics/reset/dspg/Kconfig"

endif
```

## drivers/synaptics/reset/dspg/Kconfig
```kconfig
config DVF101_RESET
	bool
	default y if ARCH_DVF101

config DVF99_RESET
	bool
	default y if ARCH_DVF
```

## drivers/synaptics/rtc/Kconfig
```kconfig
# SPDX-License-Identifier: GPL-2.0-only
#
# RTC class/drivers configuration
#

menuconfig SYNAPTICS_RTC
  bool "Synaptics rtc driver support"
  default y
  help
    Synaptics rtc driver support

if SYNAPTICS_RTC

config RTC_DRV_DSPG
	tristate "DSPG RTC support"
	help
	  DSPG RTC support

endif
```

## drivers/synaptics/soc/Kconfig
```kconfig
# SPDX-License-Identifier: GPL-2.0-only
#

menuconfig SYNAPTICS_SOC
  bool "Synaptics soc driver support"
  default y
  help
    Synaptics soc driver support

if SYNAPTICS_SOC

source "drivers/synaptics/soc/berlin/Kconfig"

endif
```

## drivers/synaptics/soc/berlin/Kconfig.avio
```kconfig
#
# AVIO variants
#

if ARCH_BERLIN

choice
	prompt	"Synaptics AVIO Variants"
	default	AVIO_NONE

config AVIO_NONE
	bool	"Not select any AVIO variant in default"

config AVIO_AS370
	bool	"Synaptics AS370"

config AVIO_MYNA
	bool	"Synaptics MYNA"

config AVIO_MYNA2
        bool    "Synaptics MYNA2"

config AVIO_PLATYPUS
	bool	"Synaptics PLATYPUS"

config AVIO_DOLPHIN
	bool	"Synaptics DOLPHIN"

config AVIO_DOLPHIN_A0
	bool	"Synaptics DOLPHIN A0"

endchoice

endif
```

## drivers/synaptics/soc/berlin/Kconfig.gpu
```kconfig
#
# GPU variants
#

choice
	prompt	"Synaptics GPU Variants"
	default	GPU_PLATYPUS

config GPU_PLATYPUS
	bool	"Synaptics PLATYPUS"

config GPU_DOLPHIN
	bool	"Synaptics DOLPHIN"

config GPU_MYNA2
	bool	"Synaptics MYNA2"

endchoice
```

## drivers/synaptics/soc/berlin/Kconfig.isp
```kconfig
#
# ISP variants
#

if SYNA_ISP

choice
	prompt	"Synaptics ISP Variants"
	default	ISP_NONE

config ISP_NONE
	bool	"Not select any ISP variant in default"

config ISP_DOLPHIN
	bool	"Synaptics DOLPHIN"

config ISP_DOLPHIN_A0
	bool	"Synaptics DOLPHIN A0"

endchoice

config SYNA_ISP_BE
	tristate "Support ISP BE Common utilities"
	depends on SYNA_ISP
	default n
	help
		isp be common utilities

config SYNA_ISP_SCALER
	tristate "Support for ISP Scaler component"
	depends on VIDEO_DEV && SYNA_ISP
	select V4L2_MEM2MEM_DEV
	default n
	help
		isp scaler driver

config VIDEO_VVCAM_DRIVER
	tristate "Support VVCAM ISP driver"
	depends on  VIDEO_DEV
	select MEDIA_CONTROLLER
	select VIDEO_V4L2_SUBDEV_API
	select V4L2_FWNODE
	select VIDEOBUF2_DMA_CONTIG
	help
		vvcam isp driver

config SYNA_ISP_DMA_HEAP
	tristate "Support for ISP DMA HEAP for DMA Memory"
	default n
	help
		isp dma heap

endif
```

## drivers/synaptics/spi/Kconfig
```kconfig
# SPDX-License-Identifier: GPL-2.0-only
#
# SPI driver configuration
#
menuconfig SYNAPTICS_SPI
  bool "Synaptics spi driver support"
  default y
  help
    Synaptics spi driver support

if SYNAPTICS_SPI

config SPI_DSPG_DMW
	tristate "DSP Group DMW96 style SPI controller"
	depends on HAS_DMA
	depends on OF
	select SPI_BITBANG
	select DMADEVICES
	select DVF_GDMAC
	help
	  SPI master driver for DMW96 style controllers.

config SPI_DSPG_DCX
	tristate "DSP Group DCX81 style SPI controller"
	depends on OF
	select SPI_BITBANG
	help
	  SPI master driver for DCX81 style controllers.

endif
```

## drivers/synaptics/staging/Kconfig
```kconfig
# SPDX-License-Identifier: GPL-2.0
#

menuconfig SYNAPTICS_STAGING
  bool "Synaptics staging driver support"
  default y
  help
    Synaptics STAGING driver support

if SYNAPTICS_STAGING

source "drivers/synaptics/staging/dspg/Kconfig"

endif
```

## drivers/synaptics/staging/dspg/Kconfig
```kconfig
menuconfig DSPG
	bool "DSPG Drivers"
	default n

if DSPG

config DSPG_SEC
	bool "Semaphore Exchange Center (SEC)"

config DSPG_CSS
	depends on DSPG_SEC
	bool "CSS firmware loader"

source "drivers/synaptics/staging/dspg/coma/Kconfig"

config DESIGNWARE_DSI
	default n
	bool "Synopsys DesignWare DSI driver"

config DSPG_CRYPTO
	bool "DSPG Cryptograpic security module"
	help
	  Enable support for the Crypthograpic security module of DSPG.

config DSPG_DDR_PERF
	tristate "DDR Performance Counters"
	depends on SYSFS
	help
	  Enable sysfs interface for DDR performance counters.

config DSPG_DDR_PMU
	bool "DDR PMU for DVF101"
	help
	  Enable support for the PMU Framework for DDR.

config DSPG_TPS65132B2
	tristate "DSPG TPS65132B2 driver"
	depends on I2C
	depends on OF_GPIO
	default n
	help
	  TPS65132B2 dual voltage out

config DSPG_PIOG
	tristate "DSPG PIO Guardian"
	depends on OF_GPIO
	default n

config DSPG_CPUFREQ
	tristate "DSPG CPU frequency scaling driver"
	depends on OF
	default n

if I2C_SLAVE

config I2C_SLAVE_DVF99
       tristate "I2C DVF99 slave driver"

endif

endif
```
