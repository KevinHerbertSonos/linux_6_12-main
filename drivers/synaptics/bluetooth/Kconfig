## drivers/synaptics/bluetooth/Kconfig
```kconfig
# SPDX-License-Identifier: GPL-2.0


menuconfig SYNAPTICS_BLUETOOTH
  bool "Synaptics bluetooth driver support"
  default y
  help
    Synaptics bluetooth driver support

if SYNAPTICS_BLUETOOTH

config BT_RFKILL
	tristate "Synaptics bluetooth rfkill"
	default n
	help
	  Synaptics bluetooth rfkill


config BT_LPM
	tristate "Synaptics bluetooth lpm"
	default n
	help
	  Synaptics bluetooth lpm

endif
```

## drivers/synaptics/clk/Kconfig
```kconfig
# SPDX-License-Identifier: GPL-2.0-only
#

menuconfig SYNAPTICS_CLK
  bool "Synaptics clock driver support"
  default y
  help
    Synaptics clock driver support

if SYNAPTICS_CLK

source "drivers/synaptics/clk/berlin/Kconfig"

source "drivers/synaptics/clk/dspg/Kconfig"

endif
```

## drivers/synaptics/clk/dspg/Kconfig
```kconfig
config COMMON_CLK_DSPG
	bool "Dspg common clock drivers"
	depends on OF
	help
	  Dspg common clock drivers
```

## drivers/synaptics/clocksource/Kconfig
```kconfig
# SPDX-License-Identifier: GPL-2.0-only
#

menuconfig SYNAPTICS_CLOCKSOURCE
  bool "Synaptics clock source driver support"
  default y
  help
    Synaptics clock source driver support

if SYNAPTICS_CLOCKSOURCE

config CLKSRC_DSPG_RTC
	bool
	select TIMER_OF if OF
	depends on PLAT_DVF
	default y if !COMMON_CLK_DSPG

config CLKSRC_DSPG_TIMER
	bool
	depends on PLAT_DVF
	select TIMER_OF if OF
	default y if !COMMON_CLK_DSPG

config CLKSRC_DSPG
	bool
	depends on PLAT_DVF
	select TIMER_OF if OF
	default y if COMMON_CLK_DSPG

config SSE_TIMER
	bool "ARM SSE(Subsystems for Embedded) system timer driver"
	depends on COMMON_CLK
	default n
	help
	  Enables support for the ARM SSE(Subsystems for Embedded) system timer driver.

endif
```

## drivers/synaptics/devfreq/Kconfig
```kconfig
# SPDX-License-Identifier: GPL-2.0-only

menuconfig SYNAPTICS_DEVFREQ
  bool "Synaptics devfreq driver support"
  default y
  help
    Synaptics devfreq driver support

if SYNAPTICS_DEVFREQ

config SYNA_DVFS
	tristate "Synaptics DVFS driver"
	help
	  This adds the DEVFREQ driver for the synaptics DVFS

endif
```

## drivers/synaptics/dma-buf/Kconfig
```kconfig
# SPDX-License-Identifier: GPL-2.0-only

menuconfig SYNAPTICS_DMABUF
  bool "Synaptics dma buf driver support"
  default y
  help
    Synaptics dma buf driver support

if SYNAPTICS_DMABUF

source "drivers/synaptics/dma-buf/heaps/Kconfig"

endif
```

## drivers/synaptics/dma-buf/heaps/Kconfig
```kconfig
config DMABUF_HEAPS_CMA_CUST
	tristate "DMA-BUF CMA Cust Heap"
	depends on DMABUF_HEAPS && DMA_CMA && DMABUF_HEAPS_EXTRA
	help
	  Choose this option to enable dma-buf CMA Cust heap. This heap is backed
	  by the Contiguous Memory Allocator (CMA). If your system has these
	  regions, you should say Y here.

config DMABUF_HEAPS_SYSTEM_CUST
	tristate "DMA-BUF System Cust Heap"
	depends on DMABUF_HEAPS && DMABUF_HEAPS_EXTRA
	select DMABUF_HEAPS_PAGE_POOL
	select DMABUF_HEAPS_DEFERRED_FREE
	help
	  Choose this option to enable the dma-buf System Cust Heap. The system cust
	  heap is backed by pages from the buddy allocator. If in doubt, say Y.

config DMABUF_HEAPS_BERLIN
	tristate "DMA-BUF Berlin Heap"
	depends on DMABUF_HEAPS && DMABUF_HEAPS_EXTRA
	help
	  Choose this option to enable the dma-buf berlin heaps. This heap is to
	  support berlin platform related features.

config DMABUF_HEAPS_EXTRA
	tristate "DMA-BUF Heap Extra Extension"
	depends on DMABUF_HEAPS
	help
	Choose this option to enable dma heap extra functions, currently it
	only supports heap call back register.
```

## drivers/synaptics/dma/Kconfig
```kconfig
# SPDX-License-Identifier: GPL-2.0-only
#
# DMA engine configuration
#

menuconfig SYNAPTICS_DMA
  bool "Synaptics dma driver support"
  default y
  help
    Synaptics dma driver support

if SYNAPTICS_DMA

config ARM_DMA350
	tristate "Arm DMA-350 support"
	select DMA_ENGINE
	select DMA_VIRTUAL_CHANNELS
	default n
	help
	  Enable support for the Arm DMA-350 controller.

config DVF_GDMAC
	tristate "DSPG DVF GDMAC support"
	depends on ARCH_DVF101 || ARCH_DVF
	select DMA_ENGINE
	select DMA_VIRTUAL_CHANNELS
	default y
	help
	  Enable support for DSPG's DVF GDMAC.

endif
```

## drivers/synaptics/gpu/dsi/Kconfig
```kconfig
config HISI_KIRIN_DW_DSI
	tristate "HiSilicon Kirin specific extensions for Synopsys DW MIPI DSI"
	depends on OF_GPIO
	help
	 This selects support for HiSilicon Kirin SoC specific extensions for
	 the Synopsys DesignWare DSI driver. If you want to enable MIPI DSI on
	 hi6220 based SoC, you should selet this option.
```

## drivers/synaptics/gpu/vivante/Kconfig
```kconfig
config GPU_VIVANTE
	bool "GPU Vivante" if EXPERT
	default n
	help
	 Enable Vivante GPU

if GPU_VIVANTE

menu "Vivante Options"
config GPU_VIVANTE_DEBUG
	bool "Enable debug option"
	help
	 BE AWARE THAT THIS WILL NOT WORK TOGETHER WITH A NON-DEBUGGING
	 USER SPACE GPU DRIVER

config GPU_VIVANTE_PROFILER
	bool "Enable Profiler"

config GPU_VIVANTE_NEWSIGNAL
	bool "Use New Linux Signal"
endmenu

endif
```

## drivers/synaptics/hrx-v4l2/Kconfig
```kconfig
# SPDX-License-Identifier: GPL-2.0

config SYNAPTICS_HRX_V4L2
	tristate "Synaptics HDMI-Rx V4L2 driver support"
	default n
	help
	  Synaptics HDMI-Rx V4L2 driver support
```

## drivers/synaptics/hwmon/Kconfig
```kconfig
# SPDX-License-Identifier: GPL-2.0-only
#
# Hardware monitoring chip drivers configuration
#

menuconfig SYNAPTICS_HWMON
  bool "Synaptics hwmon driver support"
  default y
  help
    Synaptics hwmon driver support

if SYNAPTICS_HWMON

config SENSORS_DOLPHIN
	tristate "Synaptics DOLPHIN SoC hardware monitoring driver"
	help
	  If you say yes here you get support for the PVT sensors for
	  Synaptics DOLPHIN SoC.

endif
```

## drivers/synaptics/i2c/Kconfig
```kconfig
# SPDX-License-Identifier: GPL-2.0-only
#
# I2C subsystem configuration
#

menuconfig SYNAPTICS_I2C
  bool "Synaptics i2c driver support"
  default y
  help
    Synaptics i2c driver support

if SYNAPTICS_I2C

source "drivers/synaptics/i2c/muxes/Kconfig"

endif
```

## drivers/synaptics/i2c/muxes/Kconfig
```kconfig
# SPDX-License-Identifier: GPL-2.0-only
#
# Multiplexer I2C chip drivers configuration
#

config I2C_DYNDMX_PINCTRL
	tristate "pinctrl-based I2C dynamic demultiplexer"
	depends on PINCTRL && OF
	help
	  If you say yes to this option, support will be included for an I2C
	  demultiplexer that uses the pinctrl subsystem. This is useful if you
	  want to dynamically use different I2C master.
```

## drivers/synaptics/input/Kconfig
```kconfig
# SPDX-License-Identifier: GPL-2.0-only
#
# Input device configuration
#

menuconfig SYNAPTICS_INPUT
  bool "Synaptics input driver support"
  default y
  help
    Synaptics input driver support

if SYNAPTICS_INPUT

source "drivers/synaptics/input/keyboard/Kconfig"

source "drivers/synaptics/input/touchscreen/Kconfig"

source "drivers/synaptics/input/misc/Kconfig"

endif
```

## drivers/synaptics/input/keyboard/Kconfig
```kconfig
# SPDX-License-Identifier: GPL-2.0-only
#
# Input core configuration
#

config KEYBOARD_BERLIN_IR
	tristate "Berlin Infra-Red remote keypad support"
	depends on BERLIN_SM
	default n
	help
	  Enable support for Berlin Infra-Red remote keypad

config KEYBOARD_DSPG_TRI
	tristate "DSPG tri keypad interface driver"
	depends on MFD_CORE
	select INPUT_OF_MATRIX_KEYMAP if USE_OF
	help
	  Say Y here if you want to get support for the DSPG tri keypad interface.

	  To compile this driver as a module, choose M here: the
	  module will be called dspg-keypad.
```

## drivers/synaptics/input/misc/Kconfig
```kconfig
# SPDX-License-Identifier: GPL-2.0-only
#
# Input misc drivers configuration
#

config INPUT_FORCEMUTE
	tristate "Synaptics Forcemute support"
	help
	  Say Y here to enable the Synaptics forcemute support. An
	  input event will be triggered upon a forcemute interrupt.

	  To compile this driver as a module, choose M here: the
	  module will be called forcemute.
```

## drivers/synaptics/input/touchscreen/Kconfig
```kconfig
# SPDX-License-Identifier: GPL-2.0-only
#
# Touchscreen driver configuration
#

config TOUCHSCREEN_FT7421
	tristate "FT7421 I2C touchscreen"
	depends on I2C && OF
	help
	  Say Y here to enable support for the Focaltech FT7421 touch panel

config TOUCHSCREEN_FT5X06
	tristate "FT5X06 I2C touchscreen"
	depends on I2C && OF
	help
	  Say Y here to enable support for the Focaltech FT5X06 touch panel

config TOUCHSCREEN_DVF9A
	tristate "DVF9A based touchscreens"
	depends on MFD_DSPG_DVF9A
	help
	Say Y here if you have a DVF9A acting as a touchscreen
	controller.

	If unsure, say N.
```

## drivers/synaptics/irqchip/Kconfig
```kconfig
# SPDX-License-Identifier: GPL-2.0-only

menuconfig SYNAPTICS_IRQCHIP
  bool "Synaptics irqchip driver support"
  default y
  help
    Synaptics irqchip driver support

if SYNAPTICS_IRQCHIP

config BERLIN_DHUB_IRQ
	tristate "Synaptics DHUB Interrupt Controller"
	select GENERIC_IRQ_CHIP
	select IRQ_DOMAIN

config DSPG_PLICU
	select IRQ_DOMAIN
	select MULTI_IRQ_HANDLER
	bool
	default y
	depends on PLAT_DVF

config DSPG_EXTINT
	bool "DSPG external interrupt driver"
	default y
	select IRQ_DOMAIN
	depends on PINCTRL_DVF101 && OF

endif
```

## drivers/synaptics/leds/Kconfig
```kconfig
# SPDX-License-Identifier: GPL-2.0-only

menuconfig SYNAPTICS_LEDS
  bool "Synaptics leds driver support"
  default y
  help
    Synaptics leds driver support

if SYNAPTICS_LEDS

config LEDS_CPLD
	tristate "LED support for the DSPG-EVB with CPLD"
	depends on LEDS_CLASS && (ARCH_DVF || ARCH_DVF101)
	help
	  This option enables support for the LEDs on the DSPG-EVB (controlled
	  through the CPLD). Say Y to enable LEDs on the DSPG-EVB.

config LEDS_TLC5917
	tristate "LED support for TLC5917"
	depends on LEDS_CLASS
	help
	  Say Y to enable TLC5917 LED support.

endif
```

## drivers/synaptics/mailbox/Kconfig
```kconfig
# SPDX-License-Identifier: GPL-2.0-only

#
# Watchdog device configuration
#

menuconfig SYNAPTICS_MAILBOX
  bool "Synaptics Mailbox driver support"
  default y
  help
    Synaptics mailbox driver support

if SYNAPTICS_MAILBOX

config SYNA_IPC
	tristate "Synaptics IPC Driver"
	depends on MAILBOX
	default n
	help
	  Synaptics Inter-Processor Communication (IPC) driver. The driver
	  is used for communication between the application CPUs and various
	  coprocessor. On the other hand, the driver also acts as HWSPINLOCK.

endif
```

## drivers/synaptics/mfd/Kconfig
```kconfig
# SPDX-License-Identifier: GPL-2.0-only
#
# Multifunction miscellaneous devices
#

menuconfig SYNAPTICS_MFD
  bool "Synaptics mfd driver support"
  default y
  help
    Synaptics mfd driver support

if SYNAPTICS_MFD

config MFD_DSPG_DVF9A
	tristate "Support for DSPG-DVF9A including DAIF interface"
	select MFD_CORE
	help
	  Select this option to get support for the DSPG-DVF9 chip,
	  including access to the DAIF interface.

endif
```

## drivers/synaptics/misc/Kconfig
```kconfig
# SPDX-License-Identifier: GPL-2.0-only
#
# Misc strange devices
#

menuconfig SYNAPTICS_MISC
  bool "Synaptics msic driver support"
  default y
  help
    Synaptics MISC driver support

if SYNAPTICS_MISC

config DSPG_CCU
	bool "DSPG coherency control unit (CCU)"
	depends on PLAT_DVF
	default y if PLAT_DVF
	help
	  Add support for the CCU.

endif
```

## drivers/synaptics/mmc/Kconfig
```kconfig
# SPDX-License-Identifier: GPL-2.0-only
#
# MMC subsystem configuration
#

menuconfig SYNAPTICS_MMC
  bool "Synaptics mmc driver support"
  default y
  help
    Synaptics MMC driver support

if SYNAPTICS_MMC

source "drivers/synaptics/mmc/host/Kconfig"

endif
```

## drivers/synaptics/mmc/host/Kconfig
```kconfig
# SPDX-License-Identifier: GPL-2.0-only
#
# MMC/SD host controller drivers
#

config MMC_SDHCI_OF_DWCMSHC
	tristate "SDHCI OF support for the Synopsys DWC MSHC"
	depends on MMC_SDHCI_PLTFM
	depends on OF
	depends on COMMON_CLK
	help
	  This selects Synopsys DesignWare Cores Mobile Storage Controller
	  support.
	  If you have a controller with this interface, say Y or M here.
	  If unsure, say N.

config MMC_DW_DSPG
	tristate "DSPG specific extensions for Synopsys DW Memory Card Interface"
	depends on MMC_DW
	select MMC_DW_PLTFM
```
